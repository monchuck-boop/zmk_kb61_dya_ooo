## config/Kconfig
```kconfig
config ZMK_KSCAN_GPIO_DUPLEX
    bool "GPIO Duplex Matrix Kscan Driver"
    default y
    depends on GPIO
```

## config/boards/shields/keyball61/Kconfig.shield
```kconfig
config SHIELD_KEYBALL61_LEFT
    def_bool $(shields_list_contains,keyball61_left)

config SHIELD_KEYBALL61_RIGHT
    def_bool $(shields_list_contains,keyball61_right)

config ZMK_KSCAN_GPIO_DUPLEX
    bool
    default y
```

## config/dts/bindings/kscan/zmk,kscan-gpio-duplex.yaml
```yaml
description: GPIO Duplex Matrix Kscan Driver (col2row + row2col)

compatible: "zmk,kscan-gpio-duplex"

include: kscan.yaml

properties:
  row-gpios:
    type: phandle-array
    required: true
  col-gpios:
    type: phandle-array
    required: true
  debounce-press-ms:
    type: int
    default: 5
  debounce-release-ms:
    type: int
    default: 5
  poll-period-ms:
    type: int
    default: 10
```
